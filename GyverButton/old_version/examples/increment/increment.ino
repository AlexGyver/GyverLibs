/*
   Пример использования библиотеки GyverButton, управляем переменной value при помощи двух кнопок
   Конструкция с isIncr делает увеличение/уменьшение переменной при нажатой кнопке с шагом по времени
*/

#define BTN1 3				// кнопка подключена сюда (PIN --- КНОПКА --- GND)
#define BTN2 4        // кнопка подключена сюда (PIN --- КНОПКА --- GND)

#include "GyverButton.h"
GButton butt1(BTN1);
GButton butt2(BTN2);
int value = 0;

void setup() {
  Serial.begin(9600);
  butt1.setIncrStep(2);         // настройка инкремента, может быть отрицательным (по умолчанию 1)
  butt1.setIncrTimeout(500);    // настрйока интервала инкремента (по умолчанию 800 мс)

  butt2.setIncrStep(-2);        // настройка инкремента, может быть отрицательным (по умолчанию 1)
  butt2.setIncrTimeout(500);    // настрйока интервала инкремента (по умолчанию 800 мс)
}

void loop() {
  butt1.tick();  // обязательная функция отработки. Должна постоянно опрашиваться
  butt2.tick();  // обязательная функция отработки. Должна постоянно опрашиваться

  if (butt1.isSingle()) {          // одиночное нажатие
    value += butt1.step;           // изменить на шаг, указанный в setIncrStep
    Serial.println(value);         // для примера выведем в порт
  }

  if (butt2.isSingle()) {          // одиночное нажатие
    value += butt2.step;           // изменить на шаг, указанный в setIncrStep
    Serial.println(value);         // для примера выведем в порт
  }

  if (butt1.isIncr()) {            // если кнопка была удержана (это для инкремента)
    value = butt1.getIncr(value);  // увеличивать/уменьшать переменную value с шагом и интервалом!
    Serial.println(value);         // для примера выведем в порт
  }

  if (butt2.isIncr()) {            // если кнопка была удержана (это для инкремента)
    value = butt2.getIncr(value);  // увеличивать/уменьшать переменную value с шагом и интервалом!
    Serial.println(value);         // для примера выведем в порт
  }
}
