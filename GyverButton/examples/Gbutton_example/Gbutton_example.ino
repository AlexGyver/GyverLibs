/*
   Пример использования библиотеки GyverButton, все возможности в одном скетче.
   - Опрос кнопки с программным антидребезгом контактов
   - Отработка нажатия, удерживания отпускания кнопки
   - Отработка одиночного, двойного и тройного нажатия (вынесено отдельно)
   - Отработка любого количества нажатий кнопки (функция возвращает число нажатий)
   - Отработка нажатия и удержания кнопки
   - Настраиваемый таймаут повторного нажатия/удержания
   - Функция изменения значения переменной с заданным шагом и заданным интервалом по времени

   isPress() - возвращает true при нажатии на кнопку
   isRelease() - возвращает true при отпускании кнопки
   isClick() - возвращает true при "клике"
   isHolded() - возвращает true при удержании дольше таймаута. 
                Возвращает один раз до следующего нажатия!!!
   isHold() - возвращает true при удержании дольше таймаута.
                 Продолжает срабатывать, пока кнопка удерживается!
   isStep() - очень интересная функция. Начинает возвращать true после удержания,
              причём делает это с периодом stepTimeout. Удобно для инкрементов, см. пример
   state() - возвращает состояние кнопки (для служебных целей, заменяет digitalRead)
   
   isSingle() - возвращает true при клике. Но возвращает с паузой, 
                так как входит в режим отработки нескольких кликов
   isDouble() - возвращает true при двойном клике
   isTriple() - возвращает true при тройном клике
   hasClicks() - возвращает true при наличии нескольких кликов
   getClicks() - получает несколько кликов, если есть. Использовать в связке с hasClicks
*/

#define PIN 3				// кнопка подключена сюда (PIN --- КНОПКА --- GND)

#include "GyverButton.h"
GButton butt1(PIN);
int value = 0;

void setup() {
  Serial.begin(9600);

  butt1.setDebounce(80);        // настройка антидребезга (по умолчанию 80 мс)
  butt1.setTimeout(300);        // настройка таймаута на удержание (по умолчанию 500 мс)
}

void loop() {
  butt1.tick();  // обязательная функция отработки. Должна постоянно опрашиваться

  if (butt1.isClick()) Serial.println("Click");         // проверка на один клик
  if (butt1.isSingle()) Serial.println("Single");       // проверка на один клик
  if (butt1.isDouble()) Serial.println("Double");       // проверка на двойной клик
  if (butt1.isTriple()) Serial.println("Triple");       // проверка на тройной клик

  if (butt1.hasClicks())                                // проверка на наличие нажатий
    Serial.println(butt1.getClicks());                  // получить (и вывести) число нажатий

  if (butt1.isPress()) Serial.println("Press");         // нажатие на кнопку (+ дебаунс)
  if (butt1.isRelease()) Serial.println("Release");     // отпускание кнопки (+ дебаунс)
  if (butt1.isHolded()) Serial.println("Holded");       // проверка на удержание
  if (butt1.isHold()) Serial.println("Holding");        // проверка на удержание
  //if (butt1.state()) Serial.println("Hold");          // возвращает состояние кнопки

  if (butt1.isStep()) {                                 // если кнопка была удержана (это для инкремента)
    value++;                                            // увеличивать/уменьшать переменную value с шагом и интервалом
    Serial.println(value);                              // для примера выведем в порт
  }
}
