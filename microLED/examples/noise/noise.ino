// пример работы с шумом

#define STRIP_PIN 2     // пин ленты
#define NUMLEDS 20      // кол-во светодиодов

#include <microLED.h>
microLED<NUMLEDS, STRIP_PIN, MLED_NO_CLOCK, LED_WS2818, ORDER_GRB, CLI_AVER> strip;
#include <FastLEDsupport.h>    // нужна для шума

void setup() {
  strip.setBrightness(150);
  // реализация гармонического шума Перлина взята из FastLED и представлена функциями
  // inoise8(x), inoise8(x, y), inoise8(x, y, z) - возвращает 8 бит шум (0-255)
  // inoise16(x), inoise16(x, y), inoise16(x, y, z) - возвращает 16 бит шум (0-65 535)
  // все координаты 32 битные (0 - 4 294 967 296)

  // В одномерном случае мы передаём в функцию величину и получаем соответствующее ей значение
  // Если величина растёт линейно, на выходе из функции шума получится гармонический "плавный" ряд значений
  // Открой плоттер и увидишь график
  Serial.begin(9600);
  for (int i = 0; i < 5000; i += 10)  Serial.println(inoise8(i));

  // в двумерном случае можно вывести шум на ленту, используя его для изменения палитры
  // первая координата - движение шума по горизонтали, обеспечивает плавное изменение между пикселями
  // вторая - движение по вертикали, делает общее изменение для всего горизонтального отрезка

  // в трёхмерном случае получаем "срез" плоскостью из объёмного шума, вертикальной координатой является третья
  // смотри пример с эффектами на матрице

  // рассмотрим пример с градиентом и 2D шумом на ленте

  // создадим "огненный" градиент от чёрного к белому через красный и жёлтый
  mGradient<4> myGrad;
  myGrad.colors[0] = mBlack;
  myGrad.colors[1] = mRed;
  myGrad.colors[2] = mYellow;
  myGrad.colors[3] = mWhite;

  int count = 0;
  for (;;) {
    for (int i = 0; i < NUMLEDS; i++) {
      // проходим по всей ленте
      // inoise8 вернёт 0-255
      // градиент будет брать значение шума, размер градиента 255 (как максимум шума)
      // i*50 - шаг шума по горизонтали
      // count - общее движение шума по вертикали
      strip.leds[i] = myGrad.get(inoise8(i * 50, count), 255);
    }
    count += 20;
    strip.show();
    delay(40);
  }
}

void loop() {
}
